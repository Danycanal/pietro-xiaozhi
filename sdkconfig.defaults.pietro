## sdkconfig.defaults.pietro-wsaudio
```kconfig
# Placa Waveshare ESP32-S3-AUDIO-Board + wake word "Pietro"
CONFIG_BOARD_TYPE_WAVESHARE_ESP32_S3_AUDIO_BOARD=y
CONFIG_AUDIO_BOARD_LCD_JD9853=y
CONFIG_LANGUAGE_ES_ES=y
CONFIG_USE_DEVICE_AEC=y
CONFIG_USE_CUSTOM_WAKE_WORD=y
CONFIG_CUSTOM_WAKE_WORD="pietro"
CONFIG_CUSTOM_WAKE_WORD_DISPLAY="Pietro"
CONFIG_CUSTOM_WAKE_WORD_THRESHOLD=20
CONFIG_SR_MN_EN_MULTINET7_QUANT=y
CONFIG_SR_MN_CN_NONE=y
CONFIG_WAKE_WORD_DETECTION_IN_LISTENING=y
CONFIG_SEND_WAKE_WORD_DATA=n
```
